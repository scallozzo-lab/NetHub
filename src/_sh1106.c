#include "_sh1106.h"
#include "si2c.h"
#include "fonts_5x7.h"
#include "fonts_8x8.h"
#include <stdarg.h>
#include <stdio.h>

static uint8_t _i2caddr = SH1106_I2C_ADDR;

void _SelLCD1(void)
{
    _i2caddr = SH1106_I2C_ADDR;
}

void _SelLCD2(void)
{
    _i2caddr = SH1106_I2C_ADDR_II;
}

const uint8_t smile16x16[] =
{
    // column 0
    0x3C, 0x42,
    0xA5, 0x81,
    0xA5, 0x81,
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    0x3C, 0x3C
};

// 64x32 bitmap — "Altiva" — SH1106 vertical pages
const uint8_t altiva64x32[] = {
0x00,0xE0,0xFF,0x00,0x00,0xFC,0x1F,0x00,0x00,0xFE,0x1B,0x00,0x00,0x7E,0x18,0x00,
0x00,0x3C,0x18,0x00,0x00,0x3C,0x18,0x00,0x00,0x7E,0x18,0x00,0x00,0xFE,0x1B,0x00,
0x00,0xFC,0x1F,0x00,0x00,0xE0,0xFF,0x00,0x00,0x00,0x00,0x00,0x00,0xF8,0xFF,0x01,
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0x00,0xE0,0xFF,0x00,0x00,0x00,0x00,0x00,0x00,0x00,0x00,0x00,0x00,0x00,0x00,0x00
};




// 16x16 robot face icon (vertical, page-aligned)
const uint8_t robot16x16[] =
{
    // Column 0
    0xFF, 0x01,
    // Column 1
    0x81, 0x7D,
    // Column 2
    0xBD, 0xA5,
    // Column 3
    0xA5, 0xBD,
    // Column 4
    0xA5, 0xBD,
    // Column 5
    0xBD, 0xA5,
    // Column 6
    0x81, 0x7D,
    // Column 7
    0xFF, 0x01,
    // Column 8
    0xFF, 0x01,
    // Column 9
    0x81, 0x7D,
    // Column 10
    0xBD, 0xA5,
    // Column 11
    0xA5, 0xBD,
    // Column 12
    0xA5, 0xBD,
    // Column 13
    0xBD, 0xA5,
    // Column 14
    0x81, 0x7D,
    // Column 15
    0xFF, 0x01
};

const uint8_t gear32x32[] =
{
0x00,0x00,0x00,0x00, 0x00,0x00,0x00,0x00, 0x00,0xC0,0x03,0x00, 0x00,0xF0,0x0F,0x00,
0x00,0xFC,0x3F,0x00, 0x00,0xFE,0x7F,0x00, 0x80,0xFF,0xFF,0x01, 0xC0,0xFF,0xFF,0x03,
0xE0,0x3F,0xFC,0x07, 0xF0,0x0F,0xF0,0x0F, 0xF8,0x07,0xE0,0x1F, 0xFC,0x03,0xC0,0x3F,
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0x80,0xFF,0xFF,0x01, 0xC0,0xFF,0xFF,0x03, 0xE0,0x3F,0xFC,0x07, 0xF0,0x0F,0xF0,0x0F
};



// 32x32 filled rectangle (all pixels ON)
const uint8_t rect32x32[] =
{
    // 32 columns, each column has 4 bytes (4 pages)

    // Column 0 - 31
    0xFF,0xFF,0xFF,0xFF,  // 0
    0xFF,0xFF,0xFF,0xFF,  // 1
    0xFF,0xFF,0xFF,0xFF,  // 2
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    0xFF,0xFF,0xFF,0xFF   // 31
};

// 32x32 circle (outline) - SH1106 vertical byte format
const uint8_t circle32x32[] =
{
    // Each column has 4 bytes (4 pages)

    // Col 0
    0x00,0x00,0x00,0x00,
    // Col 1
    0x00,0x00,0x00,0x00,
    // Col 2
    0x00,0x00,0x00,0x00,
    // Col 3
    0x00,0x00,0x00,0x00,

    // Col 4
    0x00,0x07,0xE0,0x00,
    // Col 5
    0x00,0x1C,0x38,0x00,
    // Col 6
    0x00,0x30,0x0C,0x00,
    // Col 7
    0x00,0x60,0x06,0x00,

    // Col 8
    0x00,0xC0,0x03,0x00,
    // Col 9
    0x01,0x80,0x01,0x80,
    // Col 10
    0x03,0x00,0x00,0xC0,
    // Col 11
    0x06,0x00,0x00,0x60,

    // Col 12
    0x0C,0x00,0x00,0x30,
    // Col 13
    0x18,0x00,0x00,0x18,
    // Col 14
    0x18,0x00,0x00,0x18,
    // Col 15
    0x30,0x00,0x00,0x0C,

    // Col 16
    0x30,0x00,0x00,0x0C,
    // Col 17
    0x18,0x00,0x00,0x18,
    // Col 18
    0x18,0x00,0x00,0x18,
    // Col 19
    0x0C,0x00,0x00,0x30,

    // Col 20
    0x06,0x00,0x00,0x60,
    // Col 21
    0x03,0x00,0x00,0xC0,
    // Col 22
    0x01,0x80,0x01,0x80,
    // Col 23
    0x00,0xC0,0x03,0x00,

    // Col 24
    0x00,0x60,0x06,0x00,
    // Col 25
    0x00,0x30,0x0C,0x00,
    // Col 26
    0x00,0x1C,0x38,0x00,
    // Col 27
    0x00,0x07,0xE0,0x00,

    // Col 28
    0x00,0x00,0x00,0x00,
    // Col 29
    0x00,0x00,0x00,0x00,
    // Col 30
    0x00,0x00,0x00,0x00,
    // Col 31
    0x00,0x00,0x00,0x00
};



void I2C_start(void);
void I2C_stop(void);
int I2C_writeByte(uint8_t data);
 
static void delay_ms(uint32_t m)
{
    DelayUs(m * 1000);
}

static void SH1106_sendCommand(uint8_t cmd)
{
  
    I2C_start();
    int ret = I2C_writeByte((_i2caddr /*<< 1*/) | 0);   // Write mode
    //printf("ack = %d \n", ret);
    //if(ret) while(1);
    ret = I2C_writeByte(0x00);                         // Control byte: Co=0, D/C=0 → command
    ret = I2C_writeByte(cmd);
    I2C_stop();
}

void SH1106_SendData(uint8_t data)
{
    I2C_start();
    I2C_writeByte((_i2caddr/* << 1*/) | 0);  // Write mode
    I2C_writeByte(0x40);                    // Control byte: data
    I2C_writeByte(data);
    I2C_stop();
}

void SH1106_clear(void)
{
    for (uint8_t page = 0; page < 8; page++)
    {
        // Seleccionar la página
        SH1106_sendCommand(0xB0 + page);

        // Setear columna inicial (offset típico del SH1106)
        SH1106_sendCommand(0x02);   // lower column start
        SH1106_sendCommand(0x10);   // higher column start

        I2C_start();
        I2C_writeByte((_i2caddr/*/ << 1*/) | 0); // Write
        I2C_writeByte(0x40);  // Control byte: write data (D/C = 1)

        // Escribir 128 bytes en cero
        for (uint16_t i = 0; i < 128; i++)
        {
            I2C_writeByte(0x00);
        }

        I2C_stop();
    }
}


void SH1106_init(void)
{
    // Recomendado por manual: espera mínima después de alimentar el display
    delay_ms(50);

    SH1106_sendCommand(0xAE);   // Display OFF

    SH1106_sendCommand(0xD5);   // Set Display Clock Divide Ratio
    SH1106_sendCommand(0x80);   // Suggested value

    SH1106_sendCommand(0xA8);   // Set Multiplex Ratio
    SH1106_sendCommand(0x3F);   // 63 → para 128x64 (0-63)

    SH1106_sendCommand(0xD3);   // Set Display Offset
    SH1106_sendCommand(0x00);   // No offset

    SH1106_sendCommand(0x40);   // Set Display Start Line = 0

    SH1106_sendCommand(0xAD);   // Charge Pump Setting
    SH1106_sendCommand(0x8B);   // Enable charge pump (internal DC/DC)

    SH1106_sendCommand(0xA1);   // Segment Remap (mirror horizontal)
    SH1106_sendCommand(0xC8);   // COM Scan Direction (mirror vertical)

    //SH1106_sendCommand(0xA0);   // Segment Remap (mirror horizontal)
    //SH1106_sendCommand(0xC0);   // COM Scan Direction (mirror vertical)

    SH1106_sendCommand(0xDA);   // Set COM Pins Hardware Configuration
    SH1106_sendCommand(0x12);   // Alt COM pin, disable left/right remap

    SH1106_sendCommand(0x81);   // Set Contrast Control
    SH1106_sendCommand(0x7F);   // Medium contrast

    SH1106_sendCommand(0xD9);   // Set Pre-charge Period
    SH1106_sendCommand(0x22);

    SH1106_sendCommand(0xDB);   // Set VCOMH Deselect Level
    SH1106_sendCommand(0x20);

    SH1106_sendCommand(0xA4);   // Entire Display ON (resume RAM content)
    SH1106_sendCommand(0xA6);   // Set Normal Display (A7 = invert)

    // Importante: el SH1106 tiene un offset de columnas
    SH1106_sendCommand(0x02);   // Low column = 2 (offset)
    SH1106_sendCommand(0x10);   // High column = 0

    SH1106_sendCommand(0xAF);   // Display ON

    delay_ms(50);

    SH1106_clear();

    /*
    SH1106_print(0, 0, "HOLA MUNDO");
    SH1106_print(2, 20, "Sebastian");
    SH1106_print8x8(4, 20, "123456789");
    //SH1106_Print16x8(2, 0, "TEST 16X8");
    //SH1106_DrawBitmap(30, 10, gear32x32, 32, 32);
    //SH1106_DrawBitmap(20, 0, circle32x32, 32, 32);
    SH1106_Printf(10, 2, "Prueba %02X", 0x4f);
    */
}


void SH1106_drawChar(uint8_t page, uint8_t col, char c)
{
    if (c < 32 || c > 126) c = '?';  // Caracter inválido

    uint16_t index = (c - 32) * 5;   // 5 bytes por carácter

    // Selecciona página
    SH1106_sendCommand(0xB0 + page);

    // Ajusta columna + offset del SH1106
    SH1106_sendCommand((col + 2) & 0x0F);          // low col
    SH1106_sendCommand(0x10 | ((col + 2) >> 4));   // high col

    // Comienza escritura de datos
    I2C_start();
    I2C_writeByte((_i2caddr /*<< 1*/) | 0);
    I2C_writeByte(0x40); // DATA

    // Enviar los 5 bytes del carácter
    for (uint8_t i = 0; i < 5; i++)
    {
        I2C_writeByte(font5x7[index + i]);
    }

    // Espacio entre caracteres
    I2C_writeByte(0x00);

    I2C_stop();
}

void SH1106_print(uint8_t page, uint8_t col, const char *str)
{
    while (*str)
    {
        SH1106_drawChar(page, col, *str++);
        col += 6; // 5 pix + 1 espacio
        if (col > 122) break;  // evita overflow
    }
}


void SH1106_drawChar8x8(uint8_t page, uint8_t col, char c)
{
    if (c < 32 || c > 126)
        c = '?';   // Caracter inválido → reemplazar

    const uint8_t *glyph = font8x8[c - 32];

    /*
        Notas:
        - Cada página del SH1106 es 8 pix de altura.
        - Un font de 8×8 encaja EXACTO en una sola página.
        - Cada byte = columna vertical de 8 bits.
        - Por lo tanto, se dibuja como 8 bytes en horizontal.
    */

    // Página
    SH1106_sendCommand(0xB0 + page);

    // Columna baja y alta (con offset de 2)
    uint8_t realCol = col + 2;

    SH1106_sendCommand(realCol & 0x0F);            // low column
    SH1106_sendCommand(0x10 | (realCol >> 4));     // high column

    // Enviar los 8 bytes del carácter
    I2C_start();
    I2C_writeByte((_i2caddr /*<< 1*/) | 0);  // Write
    I2C_writeByte(0x40); // DATA mode

    for (uint8_t i = 0; i < 8; i++)
        I2C_writeByte(glyph[i]);

    I2C_stop();
}

void SH1106_print8x8(uint8_t page, uint8_t col, const char *str)
{
    while (*str)
    {
        SH1106_drawChar8x8(page, col, *str++);
        col += 8;      // 8 pix por carácter
        if (col > 120) // evita overflow
            break;
    }
}

void SH1106_SetCursor(uint8_t x, uint8_t page)
{
    uint8_t col = x + 2;  // SH1106 offset

    SH1106_sendCommand(0xB0 | page);                 // Set page address
    SH1106_sendCommand(0x10 | (col >> 4));           // Set high nibble of column
    SH1106_sendCommand(0x00 | (col & 0x0F));         // Set low nibble of column
}

void SH1106_SendDataBlock(const uint8_t *data, uint16_t len)
{
    I2C_start();
    I2C_write((_i2caddr /*<< 1*/) | 0);  // Write mode
    I2C_write(0x40);                    // Data mode

    while (len--)
        I2C_write(*data++);

    I2C_stop();
}

void SH1106_DrawBitmap(uint8_t x, uint8_t page, 
                       const uint8_t *bmp,
                       uint8_t w, uint8_t h)
{
    uint8_t pages = h / 8;
    uint16_t index = 0;

    for (uint8_t col = 0; col < w; col++)
    {
        for (uint8_t p = 0; p < pages; p++)
        {
            SH1106_SetCursor(x + col, page + p);
            SH1106_SendData(bmp[index++]);
        }
    }
}

void SH1106_Printf(uint8_t font, uint8_t x, uint8_t page, const char *fmt, ...)
{
    char buffer[64];

    va_list args;
    va_start(args, fmt);
    vsnprintf(buffer, sizeof(buffer), fmt, args);
    va_end(args);

    switch(font)
    {
        case _FONT_5X7:
        SH1106_print(x, page, buffer);
        break;

        case _FONT_8X8:
        SH1106_print8x8(x, page, buffer);
        break;    
    }
}